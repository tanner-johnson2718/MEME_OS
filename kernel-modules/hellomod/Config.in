## kernel-modules/hellomod/Config.in
```kconfig
config BR2_PACKAGE_HELLOMOD
    bool "hellomod"
    depends on BR2_LINUX_KERNEL
    default y
    help
     No help for you
```

## kernel-modules/pdev/Config.in
```kconfig
config BR2_PACKAGE_PDEV
    bool "pdev"
    depends on BR2_LINUX_KERNEL
    default y
    help
     Enter short description here
```

## user-apps/hello/Config.in
```kconfig
config BR2_PACKAGE_HELLO
    bool "hello"
    default y
    help
     Simple example hello world user application
```

## user-apps/paddr-parser/Config.in
```kconfig
config BR2_PACKAGE_PADDR-PARSER
    bool "paddr-parser"
    help
     Physical Adrress parser using procfs
```

## user-apps/paddr/Config.in
```kconfig
config BR2_PACKAGE_PADDR
    bool "paddr"
    default y
    help
     Physical Adrress parser using procfs
```

## user-apps/rtthread/Config.in
```kconfig
config BR2_PACKAGE_RTTHREAD
    bool "RTTHREAD"
    default y
    help
     real time thread boiler plate 
```

## user-apps/spawn/Config.in
```kconfig
config BR2_PACKAGE_SPAWN
    bool "spawn"
    default y
    help
     use clone to spanw new proc 
```

## user-apps/syscall/Config.in
```kconfig
config BR2_PACKAGE_SYSCALL
    bool "syscall"
    default y
    help
     Enter short description here
```
